## drivers/clk/realtek/Kconfig
```kconfig
# SPDX-License-Identifier: GPL-2.0-only

config COMMON_CLK_RTD1295
	bool "Clock driver for Realtek RTD1295"
	depends on ARCH_REALTEK || COMPILE_TEST
	depends on OF
	default ARCH_REALTEK
	select MFD_SYSCON
	help
	  Support for the clock gates and PLLs of the CRT and ISO blocks
	  of the Realtek RTD1293/RTD1295/RTD1296 SoCs. Only the SCPU clock
	  can be reprogrammed (for cpufreq); the other PLL rates are read-only.
```

## drivers/phy/realtek/Kconfig
```kconfig
# SPDX-License-Identifier: GPL-2.0
#
# Phy drivers for Realtek platforms
#

if ARCH_REALTEK || COMPILE_TEST

config PHY_RTK_RTD_USB2PHY
	tristate "Realtek RTD USB2 PHY Transceiver Driver"
	depends on USB_SUPPORT
	select GENERIC_PHY
	select USB_PHY
	select USB_COMMON
	help
	  Enable this to support Realtek SoC USB2 phy transceiver.
	  The DHC (digital home center) RTD series SoCs used the Synopsys
	  DWC3 USB IP. This driver will do the PHY initialization
	  of the parameters.

config PHY_RTK_RTD_USB3PHY
	tristate "Realtek RTD USB3 PHY Transceiver Driver"
	depends on USB_SUPPORT
	select GENERIC_PHY
	select USB_PHY
	select USB_COMMON
	help
	  Enable this to support Realtek SoC USB3 phy transceiver.
	  The DHC (digital home center) RTD series SoCs used the Synopsys
	  DWC3 USB IP. This driver will do the PHY initialization
	  of the parameters.

config PHY_RTD1295_RLE0599
	tristate "Realtek RTD1295 RLE0599 USB2 PHY (EHCI/OHCI) driver"
	depends on OF && HAS_IOMEM
	select GENERIC_PHY
	help
	  Enable this to support the USB 2.0 PHY of the EHCI/OHCI port of
	  the Realtek RTD1295 SoC. It also ungates the OHCI clock.

endif # ARCH_REALTEK || COMPILE_TEST
```

## drivers/soc/realtek/Kconfig
```kconfig
# SPDX-License-Identifier: GPL-2.0-only

config RTD1295_RBUS
	bool
	help
	  Lock shared by the RTD1295 drivers whose register accesses are hit
	  by the A01 rbus erratum (eMMC, PCIe card MMIO). Selected by them.
```
